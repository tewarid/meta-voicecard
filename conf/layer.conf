## conf/layer.conf
```bitbake
# We have a conf and classes directory, add to BBPATH
BBPATH .= ":${LAYERDIR}"

# We have recipes-* directories, add to BBFILES
BBFILES += "${LAYERDIR}/recipes-*/*/*.bb \
            ${LAYERDIR}/recipes-*/*/*.bbappend"

BBFILE_COLLECTIONS += "meta-voicecard"
BBFILE_PATTERN_meta-voicecard = "^${LAYERDIR}/"
BBFILE_PRIORITY_meta-voicecard = "11"

LAYERDEPENDS_meta-voicecard = "core raspberrypi"
LAYERSERIES_COMPAT_meta-voicecard = "hardknott honister"
```
